## config/west.yml
```yaml
manifest:
  remotes:
    - name: zmkfirmware
      url-base: https://github.com/zmkfirmware
    - name: cormoran  # DYA Studio (Custom Studio Protocol) 一式
      url-base: https://github.com/cormoran
    - name: caksoylar  # RGB LED
      url-base: https://github.com/caksoylar

  projects:
    # ZMK 本体を cormoran の main+dya へ差し替え（DYA Studio 対応フォーク）
    - name: zmk
      remote: cormoran
      revision: main+dya
      path: zmk
      import: app/west.yml
    # Zephyr も cormoran フォーク（4.1 + zmk-fixes + 半二重UART）で上書き
    - name: zephyr
      remote: cormoran
      revision: v4.1.0+zmk-fixes+nrf-half-duplex-uart
      clone-depth: 1
      import:
        name-blocklist:
          - ci-tools
          - hal_altera
          - hal_cypress
          - hal_infineon
          - hal_microchip
          - hal_nxp
          - hal_openisa
          - hal_xtensa
          - hal_st
          - hal_ti
          - loramac-node
          - mcuboot
          - mcumgr
          - net-tools
          - openthread
          - edtt
          - trusted-firmware-m
    # --- cormoran の DYA Studio モジュール群 ---
    - name: zmk-feature-custom-settings
      remote: cormoran
      revision: main
    - name: zmk-feature-fast-keymap
      remote: cormoran
      revision: main
    - name: zmk-feature-runtime-macro
      remote: cormoran
      revision: main
    - name: zmk-feature-runtime-combo
      remote: cormoran
      revision: main
    - name: zmk-feature-input-stream
      remote: cormoran
      revision: main
    - name: zmk-feature-module-physical-layout
      remote: cormoran
      revision: main
    - name: zmk-module-runtime-input-processor
      remote: cormoran
      revision: main
    - name: zmk-module-ble-management
      remote: cormoran
      revision: main
    - name: zmk-feature-default-layer
      remote: cormoran
      revision: codex/custom-rpc-rewrite
    - name: zmk-feature-os-detection
      remote: cormoran
      revision: main
    - name: zmk-module-settings-rpc
      remote: cormoran
      revision: main
    - name: zmk-feature-device-info
      remote: cormoran
      revision: main
    - name: zmk-feature-watchdog
      remote: cormoran
      revision: main
    - name: zmk-module-devtool
      remote: cormoran
      revision: main
    - name: zmk-feature-zephyr-setting-expose
      remote: cormoran
      revision: main
    - name: zmk-feature-kscan-diagnostics
      remote: cormoran
      revision: main
    # PMW3610 ドライバも cormoran 版へ差し替え（旧 airsrock2000-beep フォークは外した）
    - name: zmk-driver-pmw3610-with-custom-studio-rpc
      remote: cormoran
      revision: main
    # v0.3は旧ボード名(seeeduino_xiao_ble)向けoverlayのみ→mainはxiao_ble_zmk.overlay対応済み
    - name: zmk-rgbled-widget
      remote: caksoylar
      revision: main

  self:
    path: config
```
